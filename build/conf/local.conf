## build/conf/local.conf
```bitbake
# Supported machines
MACHINE ?= "chip"

# RaspberryPi specific variables
#GPU_MEM = "16"

# Set this to 1 if debug image is desired
#DEBUG_IMAGE = "1"

# Set this to make build system generate resinhup bundles
RESINHUP ?= "no"
RESIN_STAGING_BUILD = "yes"

# Enable Dev Image
DEVELOPMENT_IMAGE = "1"

# Set this to change the supervisor tag used
#TARGET_TAG ?= "master"

# Compress final SD image with xz                                                                                                                                                                                                                                              
#RESIN_SDIMG_COMPRESSION ?= "xz"                                                                                                                                                                                                                                               
                                                                                                                                                                                                                                                                               
# Parallelism Options                                                                                                                                                                                                                                                          
BB_NUMBER_THREADS ?= "${@oe.utils.cpu_count()}"                                                                                                                                                                                                                                
#BB_NUMBER_THREADS = "16"

PARALLEL_MAKE ?= "-j ${@oe.utils.cpu_count()}"                                                                                                                                                                                                                                 
#PARALLEL_MAKE = "16"
                                                                                                                                                                                                                                                                               
# Resin specific distros                                                                                                                                                                                                                                                       
DISTRO ?= "resin-systemd"                                                                                                                                                                                                                                                      

# Custom memory based TMPDIR per user/project/branch 
#TMPDIR = "/dev/shm/${CI_PROJECT_PATH}/${CI_BUILD_REF_NAME}"
#TMPDIR = "/dev/shm/iichip/resin-chip"
TMPDIR = "${HOME}/tmpdir/CI_PROJECT_PATH/CI_BUILD_REF_NAME"

# http://www.yoctoproject.org/docs/latest/ref-manual/ref-manual.html#structure-build

# Custom downloads directory                                                                                                                                                                                                                                                   
#DL_DIR ?= "${TOPDIR}/downloads"                                                                                                                                                                                                                                               
DL_DIR = "${HOME}/resin-chip-downloads"
                                                                                                                                                                                                                                                                               
# Custom sstate directory                                                                                                                                                                                                                                                      
#SSTATE_DIR = "${TMPDIR}/sstate-cache"
#SSTATE_DIR = "${HOME}/tmpdir/iichip/resin-chip/${CI_BUILD_REF_NAME}/sstate-cache"

# http://www.yoctoproject.org/docs/latest/ref-manual/ref-manual.html#var-DEPLOY_DIR
DEPLOY_DIR
# http://www.yoctoproject.org/docs/latest/ref-manual/ref-manual.html#var-DEPLOY_DIR_IMAGE

# http://www.yoctoproject.org/docs/latest/ref-manual/ref-manual.html#var-WORKDIR
# looks like it MUST be under tmpdir and is dynamic per recipe

# Inheriting this class has shown to speed up builds due to significantly lower                                                                                                                                                                                                
# amounts of data stored in the data cache as well as on disk.                                                                                                                                                                                                                 
# http://www.yoctoproject.org/docs/latest/mega-manual/mega-manual.html#ref-classes-rm-work                                                                                                                                                                                     
# INHERIT += "rm_work"                                                                                                                                                                                                                                                          
                                                                                                                                                                                                                                                                               
# Remove the old image before the new one is generated to save disk space when RM_OLD_IMAGE is set to 1, this is an easy way to keep the DEPLOY_DIR_IMAGE clean.                                                                                                               
RM_OLD_IMAGE = "1"                                                                                                                                                                                                                                                             
                                                                                                                                                                                                                                                                               
# Package Management configuration                                                                                                                                                                                                                                             
PACKAGE_CLASSES ?= "package_rpm"                                                                                                                                                                                                                                               
                                                                                                                                                                                                                                                                               
# Additional image features                                                                                                                                                                                                                                                    
USER_CLASSES ?= "buildstats image-mklibs image-prelink"                                                                                                                                                                                                                        

# By default disable interactive patch resolution (tasks will just fail instead):
PATCHRESOLVE = "noop"

# Disk Space Monitoring during the build
BB_DISKMON_DIRS = "\
    STOPTASKS,${TMPDIR},1G,100K \
    STOPTASKS,${DL_DIR},1G,100K \
    STOPTASKS,${SSTATE_DIR},1G,100K \
    ABORT,${TMPDIR},100M,1K \
    ABORT,${DL_DIR},100M,1K \
    ABORT,${SSTATE_DIR},100M,1K"

CONF_VERSION = "1"
```
